## board/sunxi/Kconfig
```kconfig
if TARGET_SUN4I

config SYS_CONFIG_NAME
	default "sun4i"

endif

if TARGET_SUN5I

config SYS_CONFIG_NAME
	default "sun5i"

endif

if TARGET_SUN7I

config SYS_CONFIG_NAME
	default "sun7i"

endif

if TARGET_SUN4I || TARGET_SUN5I || TARGET_SUN7I

config SYS_CPU
	default "armv7"

config SYS_BOARD
	default "sunxi"

config SYS_SOC
	default "sunxi"

config FDTFILE
	string "Default fdtfile env setting for this board"

config VIDEO
	boolean "Enable graphical uboot console on HDMI"
	default y
	---help---
	Say Y here to add support for using a cfb console on the HDMI output
	found on most sunxi devices.

endif
```

## configs/ICOU_Fatty_I_defconfig
```kconfig
CONFIG_SPL=y
CONFIG_SYS_EXTRA_OPTIONS="AXP209_POWER"
CONFIG_FDTFILE="sun7i-a20-icou_fatty_i.dtb"
CONFIG_VIDEO_LCD_MODE="x:768,y:1024,depth:18,pclk_khz:66000,le:56,ri:60,up:30,lo:36,hs:64,vs:50,sync:3,vmode:0"
CONFIG_VIDEO_LCD_PANEL_MIPI_4_LANE_513_MBPS_VIA_SSD2828=y
CONFIG_VIDEO_LCD_SSD2828_RESET="PH24"
CONFIG_VIDEO_LCD_RESET="PH23"
CONFIG_VIDEO_LCD_UNKNOWN="PH22"
CONFIG_VIDEO_LCD_SPI_CS="PA5"
CONFIG_VIDEO_LCD_SPI_SCLK="PA6"
CONFIG_VIDEO_LCD_SPI_MOSI="PA7"
CONFIG_VIDEO_LCD_SPI_MISO="PA8"
CONFIG_VIDEO_LCD_POWER="PH8"
CONFIG_VIDEO_LCD_BL_EN="PH7"
CONFIG_VIDEO_LCD_BL_PWM="PB2"
CONFIG_USB_KEYBOARD=n
+S:CONFIG_ARM=y
+S:CONFIG_ARCH_SUNXI=y
+S:CONFIG_MACH_SUN7I=y
+S:CONFIG_TARGET_ICOU_FATTY_I=y
```

## configs/MSI_Primo81_defconfig
```kconfig
CONFIG_SPL=y
CONFIG_SYS_EXTRA_OPTIONS=""
CONFIG_FDTFILE="sun6i-a31s-primo81.dtb"
CONFIG_VIDEO_LCD_MODE="x:768,y:1024,depth:18,pclk_khz:66000,le:56,ri:60,up:30,lo:36,hs:64,vs:50,sync:3,vmode:0"
CONFIG_VIDEO_LCD_PANEL_MIPI_4_LANE_513_MBPS_VIA_SSD2828=y
CONFIG_VIDEO_LCD_SSD2828_RESET="PA26"
CONFIG_VIDEO_LCD_SPI_CS="PH9"
CONFIG_VIDEO_LCD_SPI_SCLK="PH10"
CONFIG_VIDEO_LCD_SPI_MOSI="PH11"
CONFIG_VIDEO_LCD_SPI_MISO="PH12"
CONFIG_VIDEO_LCD_BL_EN="PA25"
CONFIG_VIDEO_LCD_BL_PWM="PH13"
CONFIG_USB_KEYBOARD=n
+S:CONFIG_ARM=y
+S:CONFIG_ARCH_SUNXI=y
+S:CONFIG_MACH_SUN6I=y
+S:CONFIG_TARGET_MSI_PRIMO81=y
+S:CONFIG_DRAM_CLK=360
+S:CONFIG_DRAM_ZQ=122
# Wifi power
+S:CONFIG_AXP221_DLDO1_VOLT=3300
```
